## sdkconfig.defaults
```kconfig
CONFIG_ESP_MAIN_TASK_STACK_SIZE=3000
CONFIG_ESP_TASK_WDT=n

CONFIG_ESP_WIFI_SSID="router-2.4G-sjk"
CONFIG_ESP_WIFI_PASSWORD="myH0u5esjk"
CONFIG_ESP_MAXIMUM_RETRY=5
CONFIG_MICRO_ROS_AGENT_IP="192.168.1.100"
CONFIG_MICRO_ROS_AGENT_PORT="8888"
```
